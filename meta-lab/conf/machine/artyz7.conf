## meta-lab/conf/machine/artyz7.conf
```bitbake
#@TYPE: Machine
#@NAME: artyz7
#@DESCRIPTION: Machine configuration for the artyz7 devices

require conf/machine/zynq-generic.conf

# Yocto Zynq-7000 device-tree variables
YAML_CONSOLE_DEVICE_CONFIG:pn-device-tree = "ps7_uart_0"
YAML_DT_BOARD_FLAGS = "{BOARD template}"

# Yocto Zynq-7000 FSBL variables
YAML_SERIAL_CONSOLE_STDIN:pn-fsbl-firmware = "ps7_uart_0"
YAML_SERIAL_CONSOLE_STDOUT:pn-fsbl-firmware = "ps7_uart_0"

MACHINE_FEATURES:remove = "rtc"
		
# Zynq-7000 QEMU Configurations
QB_DEFAULT_KERNEL:zynq = "u-boot.elf"
QB_OPT_APPEND:zynq = " \
	-serial mon:stdio \
	-boot mode=5 \
	-gdb tcp::9001 \
	-device loader,addr=0xf8000008,data=0xDF0D,data-len=4 \
	-device loader,addr=0xf8000140,data=0x00500801,data-len=4 \
	-device loader,addr=0xf800012c,data=0x1ed044d,data-len=4 \
	-device loader,addr=0xf8000108,data=0x0001e008,data-len=4 \
	-device loader,addr=0xF8000910,data=0xF,data-len=0x4 \
	-machine linux=on \
	"
	
HDF_BASE = "file://"
HDF_PATH = "/mnt/nvme/xilinx/yocto/projects/artyz7/vivado/Lab8/lab8_wrapper.xsa"
```
